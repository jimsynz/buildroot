## configs/arduino_uno_q_defconfig
```kconfig
BR2_aarch64=y
BR2_PACKAGE_HOST_LINUX_HEADERS_CUSTOM_6_16=y
BR2_TARGET_GENERIC_HOSTNAME="arduino-uno-q"
BR2_TARGET_GENERIC_ISSUE="Welcome to Arduino UNO Q"
BR2_ROOTFS_POST_IMAGE_SCRIPT="board/arduino/arduino-uno-q/post-image.sh"
BR2_LINUX_KERNEL=y
BR2_LINUX_KERNEL_CUSTOM_GIT=y
BR2_LINUX_KERNEL_CUSTOM_REPO_URL="https://github.com/arduino/linux-qcom.git"
BR2_LINUX_KERNEL_CUSTOM_REPO_VERSION="qcom-v6.16.7-unoq"
BR2_LINUX_KERNEL_USE_ARCH_DEFAULT_CONFIG=y
BR2_LINUX_KERNEL_DTS_SUPPORT=y
BR2_LINUX_KERNEL_INTREE_DTS_NAME="qcom/qrb2210-arduino-imola"
BR2_LINUX_KERNEL_INTREE_DTSO_NAMES="qcom/qrb2210-arduino-imola-gigadisplay qcom/qrb2210-arduino-imola-camera-rpiv2 qcom/qrb2210-arduino-imola-odd"
BR2_LINUX_KERNEL_DTB_OVERLAY_SUPPORT=y
BR2_LINUX_KERNEL_NEEDS_HOST_OPENSSL=y

# U-Boot bootloader (loaded by ABL from boot.img)
# Using Arduino's U-Boot fork with QRB2210/QCM2290 support
# Repository: https://github.com/arduino/u-boot
# Branch: qcom-mainline
BR2_TARGET_UBOOT=y
BR2_TARGET_UBOOT_BUILD_SYSTEM_KCONFIG=y
BR2_TARGET_UBOOT_CUSTOM_GIT=y
BR2_TARGET_UBOOT_CUSTOM_REPO_URL="https://github.com/arduino/u-boot.git"
BR2_TARGET_UBOOT_CUSTOM_REPO_VERSION="qcom-mainline"
BR2_TARGET_UBOOT_BOARD_DEFCONFIG="qcom"
BR2_TARGET_UBOOT_CONFIG_FRAGMENT_FILES="board/arduino/arduino-uno-q/uboot.config"
BR2_TARGET_UBOOT_NEEDS_DTC=y
BR2_TARGET_UBOOT_NEEDS_OPENSSL=y
BR2_TARGET_UBOOT_NEEDS_PYLIBFDT=y
BR2_TARGET_UBOOT_NEEDS_XXD=y
BR2_TARGET_UBOOT_FORMAT_CUSTOM=y
BR2_TARGET_UBOOT_FORMAT_CUSTOM_NAME="u-boot.bin"

# Firmware
BR2_PACKAGE_LINUX_FIRMWARE=y
BR2_PACKAGE_LINUX_FIRMWARE_QCOM_QCM2290=y

# Arduino Router application
BR2_PACKAGE_ARDUINO_ROUTER=y

# Host tools for packaging and flashing
BR2_PACKAGE_HOST_DOSFSTOOLS=y
BR2_PACKAGE_HOST_MTOOLS=y
BR2_PACKAGE_HOST_UBOOT_TOOLS=y
BR2_PACKAGE_HOST_GENIMAGE=y
BR2_PACKAGE_HOST_QCOM_SKALES=y
BR2_PACKAGE_HOST_QDL=y
BR2_PACKAGE_HOST_ARDUINO_UNO_Q_FIRMWARE=y
BR2_TARGET_ROOTFS_EXT2=y
BR2_TARGET_ROOTFS_EXT2_4=y
BR2_TARGET_ROOTFS_EXT2_SIZE="200M"
```

## package/arduino-router/Config.in
```kconfig
config BR2_PACKAGE_ARDUINO_ROUTER
	bool "arduino-router"
	depends on BR2_PACKAGE_HOST_GO_TARGET_ARCH_SUPPORTS
	depends on BR2_PACKAGE_HOST_GO_TARGET_CGO_LINKING_SUPPORTS
	depends on BR2_TOOLCHAIN_HAS_THREADS
	select BR2_PACKAGE_HOST_GO
	select BR2_PACKAGE_SOCAT
	select BR2_PACKAGE_LIBGPIOD
	select BR2_PACKAGE_LIBGPIOD_TOOLS
	help
	  Arduino MessagePack RPC Router for inter-process communication.

	  The router allows RPC calls between multiple MessagePack RPC clients
	  connected in a star topology network, with support for TCP, Unix
	  sockets, and serial port connections.

	  https://github.com/arduino/arduino-router

comment "arduino-router needs a toolchain w/ threads"
	depends on BR2_PACKAGE_HOST_GO_TARGET_ARCH_SUPPORTS
	depends on BR2_PACKAGE_HOST_GO_TARGET_CGO_LINKING_SUPPORTS
	depends on !BR2_TOOLCHAIN_HAS_THREADS
```

## package/arduino-uno-q-firmware/Config.in.host
```kconfig
config BR2_PACKAGE_HOST_ARDUINO_UNO_Q_FIRMWARE
	bool "host arduino-uno-q-firmware"
	help
	  Firmware and bootloader files for the Arduino UNO Q board.

	  This package provides the Qualcomm EDL firehose programmer
	  and bootloader components (xbl, abl, tz, rpm, etc.) required
	  for flashing the Arduino UNO Q via EDL mode.

	  These files are extracted from Arduino's official rescue image.

	  https://downloads.arduino.cc/debian-im/
```

## package/qcom-skales/Config.in
```kconfig
config BR2_PACKAGE_QCOM_SKALES
	bool "qcom-skales"
	help
	  Qualcomm Snapdragon Kernel Ancillary Loader and Execution Set (SKALES).

	  This package provides Qualcomm's official tools for working with
	  Qualcomm Snapdragon platforms, including:
	  - mkbootimg: Create Android-style boot images compatible with ABL
	  - dtbTool: Device tree blob manipulation tool

	  https://git.codelinaro.org/clo/qsdk/oss/tools/skales
```

## package/qdl/Config.in.host
```kconfig
config BR2_PACKAGE_HOST_QDL
	bool "host qdl"
	help
	  qdl is a tool for flashing Qualcomm devices using the
	  Emergency Download (EDL) mode via the Sahara and Firehose
	  protocols.

	  This is required for flashing Arduino UNO Q and other
	  Qualcomm-based boards.

	  https://github.com/linux-qdl/qdl
```
